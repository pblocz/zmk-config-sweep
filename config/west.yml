## config/west.yml
```yaml
manifest:
  remotes:
    - name: zmkfirmware
      url-base: https://github.com/zmkfirmware
  projects:
    - name: zmk
      remote: zmkfirmware
      revision: 309359b32f2ce46adc2b720b1cca20d9ac333d6c
      import: app/west.yml
  self:
    path: config
```
